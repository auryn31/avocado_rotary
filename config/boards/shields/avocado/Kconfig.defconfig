## config/boards/shields/avocado/Kconfig.defconfig
```kconfig
if SHIELD_AVOCADO_RIGHT

config ZMK_KEYBOARD_NAME
    default "Avocado v0.3"

config ZMK_SPLIT_ROLE_CENTRAL
    default y

config ZMK_USB
    default y

endif

if SHIELD_AVOCADO_LEFT || SHIELD_AVOCADO_RIGHT

CONFIG_EC11=y
CONFIG_EC11_TRIGGER_GLOBAL_THREAD=y

config ZMK_SPLIT
    default y

endif
```
